/* Copyright (c) 2014, The Linux Foundation. All rights reserved.
 *
 * This program is free software; you can redistribute it and/or modify
 * it under the terms of the GNU General Public License version 2 and
 * only version 2 as published by the Free Software Foundation.
 *
 * This program is distributed in the hope that it will be useful,
 * but WITHOUT ANY WARRANTY; without even the implied warranty of
 * MERCHANTABILITY or FITNESS FOR A PARTICULAR PURPOSE.  See the
 * GNU General Public License for more details.
 */

/*---------------------------------------------------------------------------
 * This file is autogenerated file using gcdb parser. Please do not edit it.
 * Update input XML file to add a new entry or update variable in this file
 * VERSION = "1.0"
 *---------------------------------------------------------------------------*/
&mdss_mdp {
	dsi_samsung_s6e3fa5_1080p_cmd: qcom,mdss_dsi_samsung_s6e3fa5_1080p_cmd {
//	qcom,cont-splash-enabled;
		qcom,mdss-dsi-panel-name = "samsung s6e3fa5 1080p cmd mode dsi panel";
		qcom,mdss-dsi-panel-manufacture = "SAMSUNG";
		qcom,mdss-dsi-panel-version = "S6E3FA5";
		qcom,mdss-dsi-backlight-version = "SAMSUNG";
		qcom,mdss-dsi-backlight-manufacture = "SAMSUNG";
		qcom,mdss-dsi-panel-controller = <&mdss_dsi0>;
		qcom,mdss-dsi-panel-type = "dsi_cmd_mode";
		qcom,mdss-dsi-panel-destination = "display_1";
		qcom,mdss-dsi-panel-framerate = <60>;
		qcom,mdss-dsi-virtual-channel-id = <0>;
		qcom,mdss-dsi-stream = <0>;
		qcom,mdss-dsi-panel-width = <1080>;
		qcom,mdss-dsi-panel-height = <1920>;
		qcom,mdss-dsi-h-front-porch = <120>;
		qcom,mdss-dsi-h-back-porch = <70>;
		qcom,mdss-dsi-h-pulse-width = <19>;
		qcom,mdss-dsi-h-sync-skew = <0>;
		qcom,mdss-dsi-v-back-porch = <4>;
		qcom,mdss-dsi-v-front-porch = <18>;
		qcom,mdss-dsi-v-pulse-width = <2>;
		qcom,mdss-dsi-h-left-border = <0>;
		qcom,mdss-dsi-h-right-border = <0>;
		qcom,mdss-dsi-v-top-border = <0>;
		qcom,mdss-dsi-v-bottom-border = <0>;
		qcom,mdss-dsi-bpp = <24>;
		qcom,mdss-dsi-color-order = "rgb_swap_rgb";
		qcom,mdss-dsi-underflow-color = <0xff>;
		qcom,mdss-dsi-border-color = <0>;
		qcom,mdss-dsi-on-command = [
			05 01 00 00 14 00 02 11 00
			15 01 00 00 00 00 02 35 00
			39 01 00 00 00 00 03 F0 5A 5A
			39 01 00 00 00 00 02 B0 04
			39 01 00 00 00 00 04 B4 06 0C 12
			39 01 00 00 00 00 03 F0 A5 A5
			15 01 00 00 00 00 02 53 20
			15 01 00 00 00 00 02 55 00
                        39 01 00 00 00 00 03 F0 5A 5A
                        39 01 00 00 00 00 02 C3 01
                        39 01 00 00 00 00 02 B0 18
                        39 01 00 00 00 00 02 C3 00
                        39 01 00 00 00 00 03 F0 A5 A5
                ];
		qcom,mdss-dsi-off-command = [05 01 00 00 28 00 02 28 00
					05 01 00 00 A0 00 02 10 00];
		qcom,mdss-dsi-post-panel-on-command = [05 01 00 00 00 00 02 29 00];
		qcom,mdss-dsi-on-command-state = "dsi_lp_mode";
		qcom,mdss-dsi-off-command-state = "dsi_hs_mode";
		qcom,mdss-dsi-h-sync-pulse = <1>;
		qcom,mdss-dsi-traffic-mode = "burst_mode";
		qcom,mdss-dsi-lane-map = "lane_map_0123";
		qcom,mdss-dsi-bllp-eof-power-mode;
		qcom,mdss-dsi-bllp-power-mode;
		qcom,mdss-dsi-lane-0-state;
		qcom,mdss-dsi-lane-1-state;
		qcom,mdss-dsi-lane-2-state;
		qcom,mdss-dsi-lane-3-state;
		qcom,mdss-dsi-panel-timings = [f0 3c 26 00 6a 6a 30 3c 32 03 04 00];
		qcom,mdss-dsi-te-pin-select = <1>;
		qcom,mdss-dsi-te-v-sync-rd-ptr-irq-line = <0x2c>;
		qcom,mdss-dsi-te-v-sync-continue-lines = <0x3c>;
		qcom,mdss-dsi-te-dcs-command = <1>;
		qcom,esd-check-enabled;
		qcom,mdss-dsi-panel-status-check-mode = "te_signal_check";
		qcom,mdss-dsi-te-check-enable;
		qcom,mdss-dsi-te-using-te-pin;
		qcom,mdss-dsi-t-clk-post = <0x0D>;
		qcom,mdss-dsi-t-clk-pre = <0x30>;
		qcom,mdss-dsi-bl-min-level = <1>;
		qcom,mdss-dsi-bl-max-level = <255>;
		qcom,mdss-dsi-dma-trigger = "trigger_sw";
		qcom,mdss-dsi-mdp-trigger = "trigger_sw";
		qcom,mdss-dsi-bl-pmic-control-type = "bl_ctrl_dcs";
		qcom,mdss-dsi-lp11-init;
		qcom,mdss-dsi-init-delay-us = <10000>;
		qcom,mdss-dsi-reset-sequence = <1 2>,<0 2>, <1 10>;
		/*qcom,mdss-dsi-panel-inverted;*/
		qcom,mdss-pan-physical-width-dimension = <68>;
		qcom,mdss-pan-physical-height-dimension = <122>;
		qcom,mdss-tear-check-frame-rate=<6000>;
		//qcom,mdss-tear-check-sync-cfg-height = <1932>; /* Height + VBP + VFP + VSW */
		//qcom,mdss-tear-check-sync-init-val= <1920>; /* Height */
	       // qcom,mdss-tear-check-sync-threshold-start = <4>;
	       // qcom,mdss-tear-check-sync-threshold-continue = <4>;
	       // qcom,mdss-tear-check-start-pos= <1920>; /* Height */
	       // qcom,mdss-tear-check-rd-ptr-trigger-intr= <1921>; /* Height + 1 */

		qcom,mdss-dsi-high-brightness-panel;
		qcom,mdss-dsi-panel-acl-command = [15 01 00 00 00 00 02 55 00];
		qcom,mdss-dsi-acl-command-state = "dsi_hs_mode";
		qcom,mdss-dsi-acl-ncmds = <0>;
		qcom,mdss-dsi-acl-npayload = <1>;
		qcom,mdss-dsi-panel-hbm-on-command = [15 01 00 00 00 00 02 53 E8];
		qcom,mdss-dsi-panel-hbm-off-command = [15 01 00 00 00 00 02 53 28];
		qcom,mdss-dsi-hbm-command-state = "dsi_hs_mode";
		/******************************************************************************/
// if you need read the lcd register value you can modify the qcom,mdss-dsi-id-command
		qcom,mdss-dsi-read-reg-enable-command  = [39 01 00 00 00 00 03 F0 5A 5A];
		qcom,mdss-dsi-read-reg-disable-command = [29 01 00 00 00 00 03 F0 A5 A5];
		qcom,mdss-dsi-packetsizetxcmds-command = [37 01 00 00 00 00 02 07 00];
		qcom,mdss-dsi-readpostxcmds-command =     [15 01 00 00 00 00 02 B0 00];
		qcom,mdss-dsi-id-command = [ 06 01 00 00 00 00 01 C3 0A 19]; //read C3 25~35th , 25=0x19
		qcom,mdss-dsi-packetsizetxcmds-command-state = "dsi_lp_mode";
		qcom,mdss-dsi-readpostxcmds-command-state    = "dsi_lp_mode";
		qcom,mdss-dsi-read-reg-enable-command-state  =  "dsi_lp_mode";
		qcom,mdss-dsi-read-reg-disable-command-state =  "dsi_lp_mode";
		qcom,mdss-dsi-id-command-state = "dsi_lp_mode";

/*****************************************************************************/
			qcom,mdss-dsi-panel-srgb-on-command = [
				39 01 00 00 00 00 03 f0 5a 5a
				39 01 00 00 00 00 02 C3 81
				39 01 00 00 00 00 02 B0 19
				39 01 00 00 00 00 16 C3 C9 00 04 49 EF 16 04 07 CF 44 DB D9 A1 06 C0 F2 EA 1B F7 f2 D7
				39 01 00 00 00 00 02 B0 18
				39 01 00 00 00 00 02 C3 01
				39 01 00 00 00 00 03 f0 A5 A5
				];
			qcom,mdss-dsi-panel-srgb-off-command = [
				39 01 00 00 00 00 03 F0 5A 5A
				39 01 00 00 00 00 02 C3 01
				39 01 00 00 00 00 02 B0 18
				39 01 00 00 00 00 02 C3 00
				39 01 00 00 00 00 03 F0 A5 A5
				];
			qcom,mdss-dsi-srgb-command-state = "dsi_hs_mode";
	/*****************************************************************************/
			qcom,mdss-dsi-panel-Adobe-rgb-on-command = [
				39 01 00 00 00 00 03 F0 5A 5A
				39 01 00 00 00 00 02 C3 81
				39 01 00 00 00 00 02 B0 18
				39 01 00 00 00 00 02 C3 11
				39 01 00 00 00 00 03 F0 A5 A5
				];
			qcom,mdss-dsi-panel-Adobe-rgb-off-command = [
				39 01 00 00 00 00 03 F0 5A 5A
				39 01 00 00 00 00 02 C3 01
				39 01 00 00 00 00 02 B0 18
				39 01 00 00 00 00 02 C3 00
				39 01 00 00 00 00 03 F0 A5 A5
				];
			qcom,mdss-dsi-Adobe-rgb-command-state = "dsi_hs_mode";
	/*****************************************************************************/
			qcom,mdss-dsi-panel-dci-p3-on-command = [
			39 01 00 00 00 00 03 f0 5A 5A
			39 01 00 00 00 00 02 C3 81
			39 01 00 00 00 00 02 B0 19
			39 01 00 00 00 00 16 C3 D8 00 00 16 D2 00 08 08 C3 1C F1 CF E8 02 C8 E9 DF 00 FF F6 D7
			39 01 00 00 00 00 02 B0 18
			39 01 00 00 00 00 02 C3 01
			39 01 00 00 00 00 03 f0 A5 A5];
			qcom,mdss-dsi-panel-dci-p3-off-command = [
			39 01 00 00 00 00 03 F0 5A 5A
			39 01 00 00 00 00 02 C3 01
			39 01 00 00 00 00 02 B0 18
			39 01 00 00 00 00 02 C3 00
			39 01 00 00 00 00 03 F0 A5 A5];
			qcom,mdss-dsi-dci-p3-command-state = "dsi_hs_mode";
			qcom,mdss-dsi-panel-night-mode-on-command = [
			39 01 00 00 00 00 03 f0 5a 5a
			39 01 00 00 00 00 02 C3 81
			39 01 00 00 00 00 02 B0 19
			39 01 00 00 00 00 16 C3 B8 03 04 45 E2 10 04 07 C1 4B EB D7 B8 0A BF FF ED 14 FF FF FF
			39 01 00 00 00 00 02 B0 18
			39 01 00 00 00 00 02 C3 01
			39 01 00 00 00 00 03 f0 A5 A5];
			qcom,mdss-dsi-panel-night-mode-off-command = [
			39 01 00 00 00 00 03 F0 5A 5A
			39 01 00 00 00 00 02 C3 01
			39 01 00 00 00 00 02 B0 18
			39 01 00 00 00 00 02 C3 00
			39 01 00 00 00 00 03 F0 A5 A5
			];
			qcom,mdss-dsi-night-mode-command-state = "dsi_hs_mode";
			qcom,mdss-dsi-panel-oneplus-mode-on-command = [
			39 01 00 00 00 00 03 f0 5a 5a
			39 01 00 00 00 00 02 C3 81
			39 01 00 00 00 00 02 B0 19
			39 01 00 00 00 00 16 C3 C0 05 03 21 FF 00 09 0C E8 28 E2 DB A1 01 A7 EF EF 00 F8 FF F1
			39 01 00 00 00 00 02 B0 18
			39 01 00 00 00 00 02 C3 01
			39 01 00 00 00 00 03 f0 A5 A5
			39 01 00 00 00 00 03 F0 5A 5A];
			qcom,mdss-dsi-panel-oneplus-mode-off-command = [
			39 01 00 00 00 00 03 F0 5A 5A
			39 01 00 00 00 00 02 C3 01
			39 01 00 00 00 00 02 B0 18
			39 01 00 00 00 00 02 C3 00
			39 01 00 00 00 00 03 F0 A5 A5];
			qcom,mdss-dsi-oneplus-mode-command-state = "dsi_hs_mode";
	/*****************************************************************************/

	};
};
