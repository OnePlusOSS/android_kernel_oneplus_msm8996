## drivers/iio/CwMcuSensor/Kconfig
```kconfig
#
# Miscellaneous I2C chip drivers configuration
#

menu "Miscellaneous I2C Chip support"

config INPUT_CWSTM32
       tristate "CyWee CWSTM32 Sensor HUB"
       depends on I2C && INPUT
       select INPUT_POLLDEV
       default y
       help
         This driver provides support for CWSTM32 Sensor HUB.

config CWSTM32_DEBUG
       tristate "CyWee CWSTM32 Sensor HUB DEBUG MECHANISM"
       depends on INPUT_CWSTM32
       help
         This driver depends on CWSTM32 Sensor HUB for enable DEBUG.

endmenu
```

## drivers/oneplus/Kconfig
```kconfig
config OEM_DEBUG_SUPORT
        bool
        default y

config OEM_TRACE_SUPORT
	default y
	depends on OEM_DEBUG_SUPORT
	bool "OEM debug function, enable it will register the device, which under /dev/otracer."

source "drivers/oneplus/coretech/Kconfig"
```

## drivers/oneplus/coretech/Kconfig
```kconfig
source "drivers/oneplus/coretech/defrag/Kconfig"
source "drivers/oneplus/coretech/opchain/Kconfig"
```

## drivers/oneplus/coretech/defrag/Kconfig
```kconfig
config DEFRAG_HELPER
	default y
	bool "Oneplus CoreTech helper, used for defrag module"
```

## drivers/oneplus/coretech/opchain/Kconfig
```kconfig
config OPCHAIN
	default y
	bool "Oneplus CoreTech helper, used for opchain module"
```
